## conf/layer.conf
```bitbake
# We have a conf and classes directory, append to BBPATH
BBPATH .= ":${LAYERDIR}"

# We have a recipes directory, add to BBFILES
BBFILES += "${LAYERDIR}/recipes-*/*/*.bb ${LAYERDIR}/recipes-*/*/*.bbappend"

BBFILE_COLLECTIONS += "meta-yocto-demos"
BBFILE_PATTERN_meta-yocto-demos := "^${LAYERDIR}/"

# Define the priority for recipes (.bb files) from this layer,
# choosing carefully how this layer interacts with all of the
# other layers.

BBFILE_PRIORITY_meta-yocto-demos = "90"

LICENSE_PATH += "${LAYERDIR}/licenses"

PREFERRED_PROVIDER_virtual/wayland-egl_raspberrypi ?= "userland"

PREFERRED_PROVIDER_virtual/wayland-egl_olinuxino-a20  = "sunxi-mali"
PREFERRED_PROVIDER_virtual/egl_olinuxino-a20  = "sunxi-mali"
PREFERRED_PROVIDER_virtual/libgles2_olinuxino-a20 = "sunxi-mali"
PREFERRED_PROVIDER_virtual/libgles1_olinuxino-a20  = "sunxi-mali"
```

## meta-tizen-raspberrypi/conf/layer.conf
```bitbake
# We have a conf and classes directory, add to BBPATH
BBPATH .= ":${LAYERDIR}"

# We have recipes-* directories, add to BBFILES
BBFILES += "${LAYERDIR}/recipes-*/*/*.bb \
	${LAYERDIR}/recipes-*/*/*.bbappend"

BBFILE_COLLECTIONS += "meta-tizen-raspberrypi"
BBFILE_PATTERN_meta-tizen-raspberrypi = "^${LAYERDIR}/"
BBFILE_PRIORITY_meta-tizen-raspberrypi = "95"


PREFERRED_PROVIDER_virtual/wayland-egl ?= "userland"
```
